## tests/lorawan/fuota_agent/testcase.yaml
```yaml
# SPDX-License-Identifier: Apache-2.0
tests:
  rzi.lorawan.fuota_agent:
    platform_allow: [native_sim]
    integration_platforms: [native_sim]
    tags: [rzi, lorawan, fuota]
```

## tests/lorawan/fuota_diff/testcase.yaml
```yaml
# SPDX-FileCopyrightText: Copyright (c) 2026 RAKwireless
# SPDX-License-Identifier: Apache-2.0
tests:
  rzi.lorawan.fuota_diff:
    tags:
      - rzi
      - lorawan
      - fuota
    platform_allow:
      - native_sim
    integration_platforms:
      - native_sim
```

## tests/lorawan/fuota_storage_lifecycle/testcase.yaml
```yaml
# SPDX-License-Identifier: Apache-2.0
tests:
  rzi.lorawan.fuota_storage_lifecycle:
    platform_allow: [native_sim]
    integration_platforms: [native_sim]
    timeout: 180
    tags: [fuota, flash]
  rzi.lorawan.fuota_apply_gates:
    platform_allow: [native_sim]
    integration_platforms: [native_sim]
    timeout: 180
    tags: [fuota, flash]
    extra_args: FUOTA_TEST_INSTALLER=ON
```

## zephyr/Kconfig.lora
```kconfig
# SPDX-FileCopyrightText: Copyright (c) 2026 RAKwireless
# SPDX-License-Identifier: Apache-2.0

config RZI_LORA
	bool "RZI raw LoRa and FSK service"
	help
	  Enable the backend-independent RZI raw LoRa and FSK service used by
	  P2P AT commands and radio certification tests.

if RZI_LORA

choice RZI_LORA_BACKEND
	prompt "Raw LoRa backend"
	default RZI_LORA_BACKEND_TEST if ZTEST
	default RZI_LORA_BACKEND_USP if RZI_LORAWAN_BACKEND_USP
	default RZI_LORA_BACKEND_ZEPHYR if LORA

config RZI_LORA_BACKEND_TEST
	bool "In-process test backend"
	depends on ZTEST
	help
	  Software loopback used by host tests. Do not use this option in
	  production firmware.

config RZI_LORA_BACKEND_USP
	bool "Semtech USP radio access controller"
	depends on RZI_LORAWAN_BACKEND_USP
	select RZI_USP
	help
	  Run P2P send and receive as USP radio access controller (RAC)
	  transactions below LoRaWAN priority, so P2P and LoRaWAN share the
	  radio. Radio certification tests (CW, PER, RSSI) use the LoRa Basics
	  Modem test mode, which suspends LoRaWAN until rzi_lora_stop().

config RZI_LORA_BACKEND_ZEPHYR
	bool "Zephyr LoRa driver"
	depends on LORA
	help
	  Use Zephyr's public <zephyr/drivers/lora.h> driver. This cannot be
	  combined with CONFIG_RZI_LORAWAN_BACKEND_USP.

endchoice

config RZI_LORA_USP_RX_IRQ_WAKE
	bool "Allow system STOP while P2P receive is listening (radio IRQ wake)"
	depends on RZI_LORA_BACKEND_USP && PM
	default y if DT_HAS_ST_STM32WL_SUBGHZ_RADIO_ENABLED
	help
	  Do not hold a PM reference merely because a P2P receive window is
	  open. The radio remains in RX and its completion or timeout IRQ
	  wakes the MCU from STOP, the USP thread queues the packet, and the
	  wake hook unblocks the AT thread. TX, pending cancellation, and
	  undelivered completions still hold a PM reference until drained.

endif # RZI_LORA
```

## zephyr/Kconfig.lorawan
```kconfig
# SPDX-FileCopyrightText: Copyright (c) 2026 RAKwireless
# SPDX-License-Identifier: Apache-2.0

config RZI_LORAWAN
	bool "RZI LoRaWAN service"
	depends on FLASH
	help
	  Enable the backend-independent RZI LoRaWAN service API.

if RZI_LORAWAN

choice RZI_LORAWAN_BACKEND
	prompt "LoRaWAN backend"
	default RZI_LORAWAN_BACKEND_USP

config RZI_LORAWAN_BACKEND_USP
	bool "Semtech USP and LoRa Basics Modem"
	select RZI_USP
	help
	  Use the Semtech USP and LoRa Basics Modem implementation. RZI owns
	  the modem; applications must not call Semtech APIs directly. Keep
	  CONFIG_LORA=n and CONFIG_LORAWAN=n so Zephyr does not drive the
	  same radio. Do not depend on !LORA here: this choice also has a
	  Zephyr option that selects LORA, and kconfiglib recurses.

config RZI_LORAWAN_BACKEND_ZEPHYR
	bool "Zephyr LoRaWAN API"
	select LORA
	select LORAWAN
	help
	  Use Zephyr's public <zephyr/lorawan/lorawan.h> stack. The LoRa
	  module backend must be loramac-node; set
	  CONFIG_LORA_MODULE_BACKEND_LORAMAC_NODE=y. Native and LoRa Basics
	  Modem radio backends are not supported. RZI owns the stack;
	  applications must not call lorawan_* APIs directly. This is not
	  the planned Zephyr LBM LoRaWAN backend.

config RZI_LORAWAN_BACKEND_TEST
	bool "In-process test backend"
	depends on ZTEST
	help
	  Select a backend supplied by a RZI unit-test application. Do not use
	  this option in production firmware.

endchoice

if RZI_LORAWAN_BACKEND_ZEPHYR

config RZI_LORAWAN_BACKEND_ZEPHYR_WORKER_STACK_SIZE
	int "Zephyr backend worker stack size"
	range 1024 8192
	default 2048
	help
	  Stack for the thread that runs blocking Zephyr lorawan_join()
	  and lorawan_send() calls.

config RZI_LORAWAN_BACKEND_ZEPHYR_WORKER_PRIORITY
	int "Zephyr backend worker preemptive priority"
	range 0 15
	default 11

endif

config RZI_LORAWAN_EVENT_QUEUE_SIZE
	int "LoRaWAN event queue depth"
	range 4 64
	default 8

config RZI_LORAWAN_MAX_CALLBACKS
	int "Maximum LoRaWAN callback subscribers"
	range 1 16
	default 4

config RZI_LORAWAN_DISPATCHER_STACK_SIZE
	int "LoRaWAN callback dispatcher stack size"
	range 1024 8192
	default 4096 if RZI_AT_COMMAND_LORAWAN
	default 2048
	help
	  Callbacks run on this stack. The AT LoRaWAN extension formats
	  downlinks here (hex buffer plus AT TX buffer), which needs more
	  than 2 KiB.

config RZI_LORAWAN_DISPATCHER_PRIORITY
	int "LoRaWAN callback dispatcher preemptive priority"
	range 0 15
	default 10

config RZI_LORAWAN_FUOTA
	bool "LoRaWAN FUOTA coordination"
	depends on RZI_MCUBOOT_DUAL_SLOT || !RZI_MCUBOOT
	select LORA_BASICS_MODEM_FUOTA if RZI_LORAWAN_BACKEND_USP
	imply LORAWAN_SERVICES if RZI_LORAWAN_BACKEND_ZEPHYR
	imply LORAWAN_APP_CLOCK_SYNC if RZI_LORAWAN_BACKEND_ZEPHYR
	imply LORAWAN_FRAG_TRANSPORT if RZI_LORAWAN_BACKEND_ZEPHYR
	imply LORAWAN_REMOTE_MULTICAST if RZI_LORAWAN_BACKEND_ZEPHYR
	help
	  Enable backend-independent FUOTA coordination for ChirpStack and
	  other LoRaWAN FUOTA servers. Clock Synchronization, Remote
	  Multicast Setup and Fragmentation stay inside the selected
	  backend. RZI owns session state, image access and optional
	  MCUboot installation. Multicast, LinkCheckReq, DeviceTimeReq,
	  and certification C APIs are always compiled; unsupported
	  backends return -RZI_ERR_NOT_SUPPORTED.

if RZI_LORAWAN_FUOTA

config RZI_LORAWAN_FUOTA_AGENT
	bool "Managed FUOTA receive lifecycle"
	default n
	depends on RZI_LORAWAN_BACKEND_TEST || (RZI_LORAWAN_BACKEND_USP && LORA_BASICS_MODEM_FUOTA_V1 && LORA_BASICS_MODEM_PROVIDED_STORAGE_IMPL)
	help
	  Manage one transparent data block, early multicast close, original A/C
	  restoration and unicast control before handing data to the FUOTA service.
	  Requires the USP v1 FUOTA observer patch.

if RZI_LORAWAN_FUOTA_AGENT

config RZI_LORAWAN_FUOTA_PRECONFIG_TIMEOUT_S
	int "Maximum setup observation time"
	range 1 86400
	default 600

config RZI_LORAWAN_FUOTA_STATUS_HOLD_S
	int "Unicast cleanup context retention deadline"
	range 1 86400
	default 120
	help
	  Keep the fragmentation control context after the original window ends
	  and settings are restored. Early completion waiting does not consume
	  this deadline. No dedicated cleanup uplink is generated by the Agent.

config RZI_LORAWAN_FUOTA_STEP_RETRY_MS
	int "Close and restore retry interval"
	range 10 60000
	default 1000

config RZI_LORAWAN_FUOTA_STEP_ATTEMPTS
	int "Maximum attempts for each recovery step"
	range 1 10
	default 3

endif

config RZI_LORAWAN_FUOTA_KEEPALIVE_INTERVAL_S
	int "Unicast keepalive interval in seconds"
	range 0 86400
	default 0
	help
	  ChirpStack advances FUOTA unicast steps after the device-profile
	  expected uplink interval. Set a non-zero value to send a one-byte
	  keepalive automatically. Zero disables the timer so the
	  application can send its own periodic uplinks.

config RZI_LORAWAN_FUOTA_KEEPALIVE_PORT
	int "Keepalive LoRaWAN port"
	range 1 223
	default 2
	depends on RZI_LORAWAN_FUOTA_KEEPALIVE_INTERVAL_S > 0

config RZI_LORAWAN_FUOTA_HW_VERSION
	hex "Hardware version reported to FMP"
	default 0x1
	help
	  32-bit hardware version returned to the Firmware Management
	  Package. ChirpStack FUOTA does not require FMP.

endif # RZI_LORAWAN_FUOTA

endif # RZI_LORAWAN

config RZI_LORAWAN_FUOTA_TRACE
	bool "Timestamped FUOTA diagnostic trace"
	depends on RZI_LORAWAN_FUOTA_AGENT && RZI_LORAWAN_BACKEND_USP
	default n
	help
	  Capture bounded source-time records and print them from a low-priority
	  thread. Intended for timing investigations; uses RAM and UART bandwidth.
	  Does not change FUOTA timers, retries or random delays.
```

## zephyr/Kconfig.usp
```kconfig
# SPDX-FileCopyrightText: Copyright (c) 2026 RAKwireless
# SPDX-License-Identifier: Apache-2.0

config RZI_USP
	bool
	select LORA_BASICS_MODEM_DRIVERS
	select USP
	select USP_LORA_BASICS_MODEM
	select USP_MAIN_THREAD
	select USP_THREADS_MUTEXES
	help
	  Shared Semtech USP platform layer. RZI owns the USP engine: it
	  initializes the platform, the radio access controller and LoRa Basics
	  Modem once, serializes API calls, and routes modem events. Selected
	  by the USP LoRaWAN and raw LoRa backends.

config RZI_USP_IDLE_UNTIL_INIT
	bool "Stay asleep until the modem is initialized"
	depends on RZI_USP
	help
	  Before the modem is initialized, the USP thread waits for
	  smtc_modem_hal_wake_up() instead of polling every 50 ms.
	  rzi_usp_unlock() issues that wake.

# Sourced before the USP Kconfig, so these are the first choice defaults
# and win over LOG_LEVEL_DEFAULT. LBM traces use the USP "lorawan" module.
if LOG && USP

choice USP_LOG_LEVEL_CHOICE
	default USP_LOG_LEVEL_OFF
endchoice

choice LORA_BASICS_MODEM_LOG_LEVEL_CHOICE
	default LORA_BASICS_MODEM_LOG_LEVEL_OFF
endchoice

choice LORA_BASICS_MODEM_DRIVERS_LOG_LEVEL_CHOICE
	default LORA_BASICS_MODEM_DRIVERS_LOG_LEVEL_OFF
endchoice

endif
```
