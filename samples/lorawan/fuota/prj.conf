## CMakeLists.txt
```
# SPDX-FileCopyrightText: Copyright (c) 2026 RAKwireless
# SPDX-License-Identifier: Apache-2.0

cmake_minimum_required(VERSION 3.20.0)

find_package(Zephyr REQUIRED HINTS $ENV{ZEPHYR_BASE})
project(rzi_lorawan_fuota)

set(UPLINK_LOG_DIR ${CMAKE_CURRENT_SOURCE_DIR}/../../../lib/uplink_log)

target_sources(app PRIVATE
  src/main.c
  src/uplink_log_rzi.c
  ${UPLINK_LOG_DIR}/src/uplink_log.c
  ${UPLINK_LOG_DIR}/src/uplink_log_frame.c
)
target_sources_ifdef(CONFIG_RZI_LORAWAN_FUOTA_AGENT app PRIVATE src/fuota_event_log.c)
target_sources_ifdef(CONFIG_APP_FUOTA_RECEIVE_DEMO app PRIVATE src/fuota_receive_demo.c)
target_include_directories(app PRIVATE ${UPLINK_LOG_DIR}/include)
```

## Kconfig
```
# SPDX-License-Identifier: Apache-2.0
mainmenu "RZI LoRaWAN FUOTA sample"

config APP_FUOTA_RECEIVE_DEMO
	bool "Read and release each completed FUOTA block"
	depends on RZI_LORAWAN_FUOTA_AGENT
	help
	  Run the receive example in the application thread after FINISHED.
	  By default the application keeps the candidate for a later decision.

source "Kconfig.zephyr"
```

## sample.yaml
```
# SPDX-FileCopyrightText: Copyright (c) 2026 RAKwireless
# SPDX-License-Identifier: Apache-2.0

sample:
  name: RZI LoRaWAN FUOTA
  description: >
    Join a LoRaWAN network and accept ChirpStack FUOTA deployments through RZI
common:
  sysbuild: true
  build_only: true
  tags:
    - rzi
    - lorawan
    - fuota
  platform_allow:
    - rak4631/nrf52840/rzi
    - rak3372_f/stm32wle5xx
  integration_platforms:
    - rak4631/nrf52840/rzi
    - rak3372_f/stm32wle5xx
tests:
  sample.rzi.lorawan.fuota: {}
  sample.rzi.lorawan.fuota.receive_demo:
    extra_args: fuota_CONFIG_APP_FUOTA_RECEIVE_DEMO=y
```

## sysbuild.conf
```
# SPDX-FileCopyrightText: Copyright (c) 2026 RAKwireless
# SPDX-License-Identifier: Apache-2.0

SB_CONFIG_BOOTLOADER_MCUBOOT=y
SB_CONFIG_MCUBOOT_MODE_SWAP_SCRATCH=y
SB_CONFIG_MERGED_HEX_FILES=y
```

## prj.conf
```kconfig
# SPDX-FileCopyrightText: Copyright (c) 2026 RAKwireless
# SPDX-License-Identifier: Apache-2.0

CONFIG_GPIO=y
CONFIG_SPI=y
CONFIG_SERIAL=y
CONFIG_FLASH=y
CONFIG_PM_DEVICE=y
CONFIG_TEST_RANDOM_GENERATOR=y

# The AT service owns its UART. Keep logs and the console off that port.
CONFIG_LOG=n
CONFIG_CONSOLE=n
CONFIG_UART_CONSOLE=n
CONFIG_UART_LINE_CTRL=y
CONFIG_USE_SEGGER_RTT=n
CONFIG_USB_DEVICE_STACK_NEXT=y
CONFIG_CDC_ACM_SERIAL_INITIALIZE_AT_BOOT=y

CONFIG_MAIN_STACK_SIZE=4096
# RAK3372 has 64 KiB RAM. The AT thread and its receive ring share that with FUOTA.
CONFIG_HEAP_MEM_POOL_SIZE=2048

CONFIG_LORA=n
CONFIG_LORAWAN=n

CONFIG_RZI=y
CONFIG_RZI_LORAWAN=y
CONFIG_RZI_AT=y
CONFIG_RZI_AT_COMMAND_LORAWAN=y
CONFIG_RZI_AT_ADAPTER_UART=y
CONFIG_RZI_AT_NVM=y
CONFIG_SETTINGS_NVS=y
CONFIG_RZI_AT_THREAD_STACK_SIZE=4096
CONFIG_RZI_AT_RX_BUFFER_SIZE=256
# Downlink formatting runs on this stack and needs more than 2 KiB.
CONFIG_RZI_LORAWAN_DISPATCHER_STACK_SIZE=3072
CONFIG_RZI_MCUBOOT=y
CONFIG_STREAM_FLASH=y
CONFIG_IMG_MANAGER=y
CONFIG_RZI_LORAWAN_FUOTA=y
CONFIG_RZI_LORAWAN_EVENT_QUEUE_SIZE=8
CONFIG_LORA_BASICS_MODEM_DRIVERS_EVENT_TRIGGER_NO_THREAD=y
# Certification, radio test mode, CSMA and FMP are not used by this sample.
CONFIG_LORA_BASICS_MODEM_CERTIFICATION=n
CONFIG_LORA_BASICS_MODEM_TEST_MODE=n
CONFIG_LORA_BASICS_MODEM_CSMA=n
CONFIG_LORA_BASICS_MODEM_FUOTA_FMP=n

# Uplink log: boot report reset reason.
CONFIG_HWINFO=y

# Match ChirpStack device-profile package versions (v1 by default).
CONFIG_LORA_BASICS_MODEM_FUOTA_V1=y
# EU868 DR2-DR4 application payloads are 51, 115 and 222 bytes. A data
# fragment keeps 3 bytes for the command and index, so the data sizes are
# 48, 112 and 219. 4438 x 48 covers one 208 KiB slot1 image at DR2.
# Redundancy is an absolute fragment count: 200 is about 20% at DR4,
# 10% at DR3 and 4.5% at DR2. The parity matrix cannot hold 20% of 4438.
CONFIG_LORA_BASICS_MODEM_FUOTA_MAX_NB_OF_FRAGMENTS_CONFIG=y
CONFIG_LORA_BASICS_MODEM_FUOTA_MAX_NB_OF_FRAGMENTS=4438
CONFIG_LORA_BASICS_MODEM_FUOTA_MAX_SIZE_OF_FRAGMENTS_CONFIG=y
CONFIG_LORA_BASICS_MODEM_FUOTA_MAX_SIZE_OF_FRAGMENTS=242
CONFIG_LORA_BASICS_MODEM_FUOTA_MAX_FRAGMENTS_REDUNDANCY_CONFIG=y
CONFIG_LORA_BASICS_MODEM_FUOTA_MAX_FRAGMENTS_REDUNDANCY=200
```

## boards/rak3372_f_stm32wle5xx.conf
```kconfig
# SPDX-FileCopyrightText: Copyright (c) 2026 RAKwireless
# SPDX-License-Identifier: Apache-2.0
# STM32WLE5 has no USB device controller. Console is lpuart1 (PA2/PA3).

CONFIG_USB_DEVICE_STACK_NEXT=n
CONFIG_CDC_ACM_SERIAL_INITIALIZE_AT_BOOT=n
CONFIG_UART_LINE_CTRL=n

# Keep the FUOTA image within slot0 regardless of module discovery order.
CONFIG_USP_LOG_LEVEL_OFF=y
CONFIG_LORA_BASICS_MODEM_LOG_LEVEL_OFF=y
CONFIG_LORA_BASICS_MODEM_DRIVERS_LOG_LEVEL_OFF=y

# Fit the managed receiver and installation service in the existing STM32WL slot.
CONFIG_LTO=y
CONFIG_ISR_TABLES_LOCAL_DECLARATION=y
# Leave space for the 2 KiB TS004 fragment-number bitmap on STM32WL.
CONFIG_LOG_BUFFER_SIZE=1024

# Reserve RAM for the external-context 4 KiB erase-sector buffer.
CONFIG_HEAP_MEM_POOL_SIZE=6144
```

## app.overlay
```dts
/* SPDX-FileCopyrightText: Copyright (c) 2026 RAKwireless */
/* SPDX-License-Identifier: Apache-2.0 */
/*
 * DevEUI, JoinEUI and AppKey come from AT commands stored in NVS.
 * This sample does not provide devicetree defaults.
 */
```

## boards/rak3372_f_stm32wle5xx.overlay
```dts
/* SPDX-FileCopyrightText: Copyright (c) 2026 RAKwireless */
/* SPDX-License-Identifier: Apache-2.0 */
/*
 * A board overlay replaces app.overlay, so include it first.
 * This sample uses LPUART1 for AT and SPI2 for the external NOR.
 * USART1 and SPI1 stay enabled on the board for other applications.
 */

#include "../app.overlay"

&usart1 {
	status = "disabled";
};

&spi1 {
	status = "disabled";
};
```

## boards/rak4631_nrf52840_rzi.overlay
```dts
/* SPDX-FileCopyrightText: Copyright (c) 2026 RAKwireless */
/* SPDX-License-Identifier: Apache-2.0 */
/*
 * A board overlay replaces app.overlay, so include it first.
 * AT uses the board alias rzi-at-uart (USB CDC). Leave zephyr,console
 * on the board UART.
 */

#include "../app.overlay"
```

## src/main.c
```c
/* SPDX-FileCopyrightText: Copyright (c) 2026 RAKwireless */
/* SPDX-License-Identifier: Apache-2.0 */

#include <errno.h>
#include <zephyr/app_version.h>
#include <zephyr/device.h>
#include <zephyr/devicetree.h>
#include <zephyr/drivers/uart.h>
#include <zephyr/kernel.h>
#include <zephyr/logging/log.h>
#include <zephyr/sys/util.h>
#if defined(CONFIG_HWINFO)
#include <zephyr/drivers/hwinfo.h>
#endif
#include <rzi/at/at.h>
#include <rzi/at/uart.h>
#include <rzi/lorawan/fuota.h>
#include <rzi/lorawan/lorawan.h>
#include <rzi/version.h>

#ifdef CONFIG_IMG_MANAGER
#include <zephyr/dfu/mcuboot.h>
#endif

#include <uplink_log.h>

#include "uplink_log_rzi.h"

static __maybe_unused void ignore_result(int result)
{
	ARG_UNUSED(result);
}

LOG_MODULE_REGISTER(rzi_fuota_sample, LOG_LEVEL_INF);

#define AT_UART_NODE       DT_ALIAS(rzi_at_uart)
#define RETRY_DELAY_S      5
#define RETRY_DELAY        K_SECONDS(RETRY_DELAY_S)
#define UPLINK_INTERVAL_MS 5000

#if !DT_NODE_EXISTS(AT_UART_NODE)
#error "The board overlay must define the rzi-at-uart alias"
#endif

#if defined(CONFIG_BOARD_RAK3372_F)
#define DEVICE_CODE UPLINK_LOG_MODULE_RAK3172_F
#elif defined(CONFIG_BOARD_RAK4631)
#define DEVICE_CODE UPLINK_LOG_MODULE_RAK4630
#else
#define DEVICE_CODE UPLINK_LOG_MODULE_UNKNOWN
#endif

struct fuota_log_item {
	uint8_t code;
	bool pause_drain;
	bool resume_drain;
	bool has_event;
};

static const struct device *const at_uart = DEVICE_DT_GET(AT_UART_NODE);
static K_SEM_DEFINE(stack_ready, 0, 1);
static K_SEM_DEFINE(join_done, 0, 1);
K_MSGQ_DEFINE(fuota_log_q, sizeof(struct fuota_log_item), 4, 4);
static volatile bool joined;
static enum rzi_fuota_state fuota_state;
static uint32_t fuota_result_generation;

static const char *tx_status_str(enum rzi_lorawan_tx_status status)
{
	switch (status) {
	case RZI_LORAWAN_EVENT_TXDONE_SENT:
		return "TXDONE_SENT";
	case RZI_LORAWAN_EVENT_TXDONE_CONFIRMED:
		return "TXDONE_CONFIRMED";
	case RZI_LORAWAN_EVENT_TXDONE_NOT_SENT:
		return "TXDONE_NOT_SENT";
	default:
		return "TXDONE_UNKNOWN";
	}
}

static void log_uplink_done(const struct rzi_lorawan_tx_result *tx)
{
	if (tx->error != 0) {
		LOG_WRN("%s: %s", tx_status_str(tx->status), rzi_err_str(tx->error));
		return;
	}
	LOG_INF("%s", tx_status_str(tx->status));
}

static const char *fuota_state_str(enum rzi_fuota_state state)
{
	switch (state) {
	case RZI_FUOTA_STATE_IDLE:
		return "idle";
	case RZI_FUOTA_STATE_READY:
		return "ready";
	case RZI_FUOTA_STATE_TRANSFERRING:
		return "transferring";
	case RZI_FUOTA_STATE_COMPLETE:
		return "complete";
	case RZI_FUOTA_STATE_FAILED:
		return "failed";
	case RZI_FUOTA_STATE_APPLYING:
		return "applying";
	default:
		return "unknown";
	}
}

static void on_event(const struct rzi_lorawan_event *event, void *user_data)
{
	ARG_UNUSED(user_data);
	uplink_log_rzi_on_lorawan_event(event);
	switch (event->type) {
	case RZI_LORAWAN_EVENT_READY:
		k_sem_give(&stack_ready);
		break;
	case RZI_LORAWAN_EVENT_STATE_CHANGED:
		if (event->state == RZI_LORAWAN_STATE_READY) {
			k_sem_give(&stack_ready);
		}
		break;
	case RZI_LORAWAN_EVENT_JOINED:
		joined = true;
		k_sem_give(&join_done);
		break;
	case RZI_LORAWAN_EVENT_JOIN_FAILED:
		joined = false;
		k_sem_give(&join_done);
		break;
	case RZI_LORAWAN_EVENT_TXDONE:
		log_uplink_done(&event->tx);
		break;
	case RZI_LORAWAN_EVENT_DOWNDATA:
		LOG_INF("Downlink: port %u, %u bytes, RSSI %d dBm, SNR %d/4 dB",
			event->downlink.port, (unsigned int)event->downlink.size,
			event->downlink.rssi_dbm, event->downlink.snr_quarter_db);
		break;
	case RZI_LORAWAN_EVENT_ERROR:
		LOG_ERR("Error: %s", rzi_err_str(event->error));
		break;
	default:
		break;
	}
}

static void queue_fuota_log(const struct fuota_log_item *item)
{
	if (k_msgq_put(&fuota_log_q, item, K_NO_WAIT) != 0) {
		LOG_WRN("FUOTA log queue full");
	}
	uplink_log_rzi_wakeup();
}

static void queue_fuota_result(const struct rzi_fuota_round *round, bool have_round)
{
	struct fuota_log_item item = {
		.resume_drain = true,
		.has_event = true,
	};

	if (have_round && round->generation != 0U && round->generation == fuota_result_generation) {
		item.has_event = false;
		queue_fuota_log(&item);
		return;
	}
	if (have_round && round->generation != 0U) {
		fuota_result_generation = round->generation;
	}
	item.code = have_round && round->write_failed ? UPLINK_LOG_EVENT_FUOTA_FLASH_FAIL
						      : UPLINK_LOG_EVENT_FUOTA_FRAG_INCOMPLETE;
	queue_fuota_log(&item);
}

static void on_fuota_state(enum rzi_fuota_state state, void *user_data)
{
	ARG_UNUSED(user_data);
	LOG_INF("FUOTA %s", fuota_state_str(state));
	/* The session ended before reconstruction reported a result. */
	if (fuota_state == RZI_FUOTA_STATE_TRANSFERRING && state == RZI_FUOTA_STATE_READY) {
		struct rzi_fuota_round round;
		bool have_round = rzi_fuota_get_round(&round) == 0;

		queue_fuota_result(have_round ? &round : NULL, have_round);
	}
	fuota_state = state;
}

static void on_fuota_session_started(void *user_data)
{
	const struct fuota_log_item item = {
		.code = UPLINK_LOG_EVENT_FUOTA_STARTED,
		.pause_drain = true,
		.has_event = true,
	};

	ARG_UNUSED(user_data);
	LOG_INF("FUOTA transfer started");
	queue_fuota_log(&item);
}

static void on_fuota_complete(int status, void *user_data)
{
	struct rzi_fuota_round round;
	bool have_round = rzi_fuota_get_round(&round) == 0;

	ARG_UNUSED(user_data);
	if (status != 0) {
		LOG_ERR("FUOTA failed: %s", rzi_err_str(status));
		queue_fuota_result(have_round ? &round : NULL, have_round);
		return;
	}
	LOG_INF("FUOTA finished");
	queue_fuota_log(&(struct fuota_log_item){.resume_drain = true});
}

static const struct rzi_lorawan_callbacks callbacks = {
	.on_event = on_event,
};

static const struct rzi_fuota_callbacks fuota_callbacks = {
	.state_changed = on_fuota_state,
	.session_started = on_fuota_session_started,
	.complete = on_fuota_complete,
};

static void submit_fuota_item(const struct fuota_log_item *item)
{
	if (item->has_event) {
		const struct uplink_log_event event = {
			.domain = UPLINK_LOG_EVENT_DOMAIN_FUOTA,
			.code = item->code,
		};

		if (uplink_log_submit_event(&event) != UPLINK_LOG_OK) {
			LOG_WRN("FUOTA log event 0x%02x not queued", item->code);
		}
	}
	if (item->pause_drain) {
		ignore_result(uplink_log_pause_drain());
	}
	if (item->resume_drain) {
		ignore_result(uplink_log_resume_drain());
	}
}

static void handle_fuota_log(void)
{
	struct fuota_log_item item;

	while (k_msgq_get(&fuota_log_q, &item, K_NO_WAIT) == 0) {
		submit_fuota_item(&item);
	}
}

static bool periodic_snapshot(void *user_data, struct uplink_log_periodic *out)
{
	ARG_UNUSED(user_data);
	out->power_source = UPLINK_LOG_POWER_SOURCE_UNKNOWN;
	out->charging_status = UPLINK_LOG_CHARGING_UNKNOWN;
	out->voltage_mv = 0U;
	out->rssi_dbm = uplink_log_rzi_last_rssi();
	out->snr_db = uplink_log_rzi_last_snr();
	out->tx_fail_count = uplink_log_rzi_tx_fail_count();
	out->health = UPLINK_LOG_HEALTH_SENSOR | UPLINK_LOG_HEALTH_POWER | UPLINK_LOG_HEALTH_SYSTEM;
	return true;
}

static enum uplink_log_reset_reason read_reset_reason(void)
{
#if defined(CONFIG_HWINFO)
	uint32_t cause;

	if (hwinfo_get_reset_cause(&cause) == 0) {
		ignore_result(hwinfo_clear_reset_cause());
		if ((cause & RESET_WATCHDOG) != 0U) {
			return UPLINK_LOG_RESET_WATCHDOG;
		}
		if ((cause & RESET_POR) != 0U) {
			return UPLINK_LOG_RESET_POWER_ON;
		}
	}
#endif
	return UPLINK_LOG_RESET_UNKNOWN;
}

static void submit_boot_report(enum uplink_log_reset_reason reset_reason, uint32_t join_failures)
{
	const struct uplink_log_boot boot = {
		.fw_version = {APP_VERSION_MAJOR, APP_VERSION_MINOR, APP_PATCHLEVEL, APP_TWEAK},
		.reset_reason = reset_reason,
		.cap_fuota = true,
		.cap_full = true,
		.cap_rollback = IS_ENABLED(CONFIG_MCUBOOT_BOOTLOADER_MODE_SWAP_SCRATCH),
		.join_fail_count = (uint8_t)MIN(join_failures, UINT8_MAX),
	};
	int rc = uplink_log_submit_boot(&boot);

	if (rc != UPLINK_LOG_OK) {
		LOG_WRN("Boot report not queued: %d", rc);
	}
}

static void confirm_running_image(void)
{
#ifdef CONFIG_IMG_MANAGER
	int rc;

	if (boot_is_img_confirmed()) {
		return;
	}
	rc = boot_write_img_confirmed();
	if (rc != 0) {
		LOG_ERR("Image confirm failed: %d", rc);
		return;
	}
	LOG_INF("Running image confirmed");
#endif
}

static int start_at(void)
{
	int rc;

	if (!device_is_ready(at_uart)) {
		return -RZI_ERR_NO_DEVICE;
	}

	/* USB CDC waits until the host opens the port. A plain UART returns. */
	if (DT_NODE_HAS_COMPAT(AT_UART_NODE, zephyr_cdc_acm_uart)) {
		uint32_t dtr = 0;

		for (int i = 0; i < 100 && dtr == 0; i++) {
			(void)uart_line_ctrl_get(at_uart, UART_LINE_CTRL_DTR, &dtr);
			k_msleep(100);
		}
	}

	rc = rzi_at_uart_init(at_uart);
	if (rc != 0) {
		return rc;
	}
	return rzi_at_publish_event("BOOT:RZI_%s_%s", rzi_version_get_string(), CONFIG_BOARD);
}

static bool credentials_stored(void)
{
	uint8_t stored[16];

	return rzi_lorawan_get_dev_eui(stored, 8) == 0 && rzi_lorawan_get_app_eui(stored, 8) == 0 &&
	       rzi_lorawan_get_app_key(stored, 16) == 0;
}

static int request_join(void)
{
	int rc;

	joined = false;
	k_sem_reset(&join_done);
	rc = rzi_lorawan_join(1, 0, RZI_LORAWAN_JOIN_INTERVAL_DEFAULT, 0);
	if (rc != 0) {
		LOG_WRN("Join rejected: %s", rzi_err_str(rc));
		return rc;
	}
	LOG_INF("Joining");
	k_sem_take(&join_done, K_FOREVER);
	if (!joined) {
		LOG_WRN("Join failed, retrying in %d s", RETRY_DELAY_S);
		return -RZI_ERR_NOT_READY;
	}
	return 0;
}

int main(void)
{
	static const uint8_t payload[] = "RZI FUOTA";
	const struct uplink_log_options log_options = {
		.device_code = DEVICE_CODE,
		.periodic_snapshot = periodic_snapshot,
	};
	enum uplink_log_reset_reason reset_reason = read_reset_reason();
	enum rzi_lorawan_region region;
	uint32_t join_failures = 0U;
	int64_t next_uplink;
	int rc;

	LOG_INF("RZI LoRaWAN FUOTA sample %d.%d.%d.%d", APP_VERSION_MAJOR, APP_VERSION_MINOR,
		APP_PATCHLEVEL, APP_TWEAK);
	rc = uplink_log_rzi_init(&log_options);
	if (rc != UPLINK_LOG_OK) {
		LOG_ERR("Uplink log init failed: %d", rc);
		return -EINVAL;
	}
	rc = rzi_fuota_register_callbacks(&fuota_callbacks);
	if (rc != 0) {
		LOG_ERR("FUOTA callback registration failed: %s", rzi_err_str(rc));
		return rc;
	}
	rc = rzi_lorawan_register_callbacks(&callbacks);
	if (rc != 0) {
		LOG_ERR("Callback registration failed: %s", rzi_err_str(rc));
		return rc;
	}
	rc = start_at();
	if (rc != 0) {
		LOG_ERR("AT start failed: %s", rzi_err_str(rc));
		return rc;
	}
	/* AT+DEVEUI, AT+APPEUI and AT+APPKEY must already be stored. */
	while (!credentials_stored()) {
		k_msleep(500);
	}
	rc = rzi_lorawan_get_region(&region);
	if (rc != 0) {
		LOG_ERR("Region read failed: %s", rzi_err_str(rc));
		return rc;
	}
	rc = rzi_lorawan_init(region);
	if (rc != 0 && rc != -RZI_ERR_ALREADY) {
		LOG_ERR("LoRaWAN init failed: %s", rzi_err_str(rc));
		return rc;
	}

	k_sem_take(&stack_ready, K_FOREVER);

	while (request_join() != 0) {
		join_failures++;
		ignore_result(rzi_lorawan_leave());
		k_sleep(RETRY_DELAY);
	}
	LOG_INF("Joined");
	confirm_running_image();
	submit_boot_report(reset_reason, join_failures);

	next_uplink = k_uptime_get();
	for (;;) {
		int64_t now = k_uptime_get();

		if (now >= next_uplink) {
			if (rzi_fuota_uplink_allowed()) {
				rc = rzi_lorawan_send(1, payload, sizeof(payload) - 1,
						      RZI_LORAWAN_MSG_UNCONFIRMED);
				if (rc != 0 && rc != -RZI_ERR_BUSY) {
					LOG_WRN("Uplink rejected: %s", rzi_err_str(rc));
				}
			}
			next_uplink = now + UPLINK_INTERVAL_MS;
		}
		handle_fuota_log();
		uplink_log_rzi_poll((uint32_t)MAX(next_uplink - k_uptime_get(), 0));
	}
}
```

## src/fuota_event_log.c
```c
/* SPDX-License-Identifier: Apache-2.0 */
#include <string.h>
#include "fuota_event_log.h"

static void put_le16(uint8_t *dst, uint16_t value)
{
	dst[0] = (uint8_t)value;
	dst[1] = (uint8_t)(value >> 8);
}

bool fuota_event_log_record(const struct rzi_fuota_event *event, struct uplink_log_event *record)
{
	const struct rzi_fuota_snapshot *s = &event->snapshot;
	const struct rzi_fuota_session_info *session = &s->session;
	const struct rzi_fuota_rx_stats *rx = &s->exit.fragments;

	if (!(session->valid & RZI_FUOTA_SESSION_FRAGMENT) || !session->fragment_count ||
	    !session->fragment_size) {
		return false;
	}
	*record = (struct uplink_log_event){.domain = UPLINK_LOG_EVENT_DOMAIN_FUOTA};
	if (event->type == RZI_FUOTA_EVENT_PHASE && s->phase == RZI_FUOTA_RECEIVING) {
		record->code = UPLINK_LOG_EVENT_FUOTA_STARTED;
		put_le16(record->data, session->fragment_count);
		record->data[2] = session->fragment_size;
		record->data[3] = session->fragment_index;
		return true;
	}
	if (event->type != RZI_FUOTA_EVENT_FINISHED || s->data.ready || !rx->valid) {
		return false;
	}
	if (rx->write_failed) {
		/* The application header stores target_version at offsets 12..15. */
		if ((rx->prefix_valid & 0xf000U) != 0xf000U) {
			return false;
		}
		record->code = UPLINK_LOG_EVENT_FUOTA_FLASH_FAIL;
		memcpy(record->data, &rx->prefix[12], sizeof(record->data));
		return true;
	}
	if (s->exit.reason != RZI_FUOTA_EXIT_TIMEOUT || !s->exit.reception_started || rx->error) {
		return false;
	}
	record->code = UPLINK_LOG_EVENT_FUOTA_FRAG_INCOMPLETE;
	put_le16(record->data, rx->received);
	put_le16(record->data + 2, session->fragment_count);
	return true;
}
```

## src/fuota_event_log.h
```c
/* SPDX-License-Identifier: Apache-2.0 */
#ifndef FUOTA_EVENT_LOG_H
#define FUOTA_EVENT_LOG_H

#include <rzi/lorawan/fuota_agent.h>
#include <uplink_log.h>

/* Convert a managed receiver notification into a report for FPort 101. */
bool fuota_event_log_record(const struct rzi_fuota_event *event, struct uplink_log_event *record);

#endif
```

## src/fuota_receive_demo.c
```c
/* SPDX-License-Identifier: Apache-2.0 */
#include <rzi/lorawan/fuota.h>
#include <zephyr/sys/util.h>

#include "fuota_receive_demo.h"

int fuota_receive_demo_consume(uint32_t generation)
{
	struct rzi_fuota_snapshot current;
	uint8_t chunk[32];
	int rc = rzi_fuota_get_snapshot(&current);

	if (rc) {
		return rc;
	}
	if (!current.data.ready || current.data.generation != generation) {
		return -RZI_ERR_NOT_FOUND;
	}
	if (current.phase != RZI_FUOTA_READY) {
		return -RZI_ERR_BUSY;
	}
	if (!current.data.length_valid || current.data.length == 0) {
		return -RZI_ERR_NO_DATA;
	}
	for (size_t offset = 0; offset < current.data.length;) {
		size_t count = MIN(sizeof(chunk), current.data.length - offset);

		rc = rzi_fuota_read_image(offset, chunk, count);
		if (rc) {
			return rc;
		}
		offset += count;
	}
	return rzi_fuota_release_data(generation);
}
```

## src/fuota_receive_demo.h
```c
/* SPDX-License-Identifier: Apache-2.0 */
#ifndef FUOTA_RECEIVE_DEMO_H
#define FUOTA_RECEIVE_DEMO_H

#include <stdint.h>

/* Application thread only. Read the entire settled generation before releasing it. */
int fuota_receive_demo_consume(uint32_t generation);

#endif
```
